## firmware/Wifi/main/Kconfig.projbuild
```kconfig
menu "Example Configuration"

    config ESP_MAX_STA_CONN
        int "Maximal STA connections"
        default 4
        help
            Max number of the STA connects to AP.

    config ESP_ENABLE_DHCP_CAPTIVEPORTAL
        bool "DHCP Captive portal"
        default y
        help
            Enables more modern DHCP-based Option 114 to provide clients with the captive portal URI
endmenu
```
